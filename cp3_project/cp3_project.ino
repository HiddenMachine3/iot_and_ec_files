#include <time.h>
#include <EloquentTinyML.h>

// This file has the TFlite model generated by the Cars_Classify_Tflite_hex.ipynb

// In the directory: G:\Users\Mouli\IIITL\AI-for-IoT\PresentationMaterials\SampleProgs\Keras\classify\cars
// Done on 7 Apr 2021
// sine_model.h contains the array you exported from the previous step with xxd or tinymlgen
#include "QSAR_model_esp32_new.h"
#include "QSAR_x_test0_data_new.h"
#include "QSAR_x_train0_data_new.h"
#include "QSAR_y_test0_data_new.h"
#include "QSAR_y_train0_data_new.h"

#define NUMBER_OF_INPUTS 8
#define NUMBER_OF_OUTPUT_FEATURES 1
#define NUMBER_OF_TEST_SAMPLES 110
#define NUMBER_OF_TRAIN_SAMPLES 436

// in future projects you may need to tweek this value: it's a trial and error process
// When 5 * 1024 was given it gave error, which can be seen by giving a reset to the board and checking the error messages
// while the model is getting created (ml.begin function call in setup)
// When you notice that the output values of the TFLite model are all zero, you should suspect that Arena size given is not enough
#define TENSOR_ARENA_SIZE 12 * 1024 // Since the size of TFLite model is around 104704 half of that is given as Arena size

Eloquent::TinyML::TfLite<NUMBER_OF_INPUTS, NUMBER_OF_OUTPUT_FEATURES, TENSOR_ARENA_SIZE> ml;

void setup()
{
    Serial.begin(115200);

    ml.begin(QSAR_model_esp32_new);
}

float y_pred[NUMBER_OF_OUTPUT_FEATURES] = {0};
float fRes = NULL;

void loop()
{
    uint32_t startTime;
    uint32_t timeIt;
    float num = 0;
    for (int i = 0; i < NUMBER_OF_TRAIN_SAMPLES; i++)
    {
        initfResult(y_pred);

        startTime = micros();
        fRes = ml.predict(x_train0[i], y_pred);
        num = y_pred[0];
        timeIt = micros() - startTime;

        Serial.print("Train " + String(i) + " took ");
        Serial.print(timeIt);
        Serial.println(" micros to run inference");

        Serial.print("\nThe x_train0 molecule has a predicted toxicity level of " + String(num) + " and the actual toxicity level is " + String(y_train0[i]) + "\n\n");
    }

    for (int i = 0; i < NUMBER_OF_TEST_SAMPLES; i++)
    {
        startTime = micros();
        fRes = ml.predict(x_test0[i], y_pred);
        num = y_pred[0];
        timeIt = micros() - startTime;

        Serial.print("Test " + String(i) + " took ");
        Serial.print(timeIt);
        Serial.println(" micros to run inference");

        Serial.print("\nThe x_test0 molecule has a predicted toxicity level of " + String(num) + " and the actual toxicity level is " + String(y_test0[i]) + "\n\n");
    }

    delay(3000); // 3 seconds of delay between two plots
}

void initfResult(float *fResult)
{
    for (int i = 0; i < NUMBER_OF_OUTPUT_FEATURES; i++)
    {
        fResult[i] = 0.0f;
    }
}